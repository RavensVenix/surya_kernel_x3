## drivers/memkernel/Kconfig
```kconfig
config MEMKERNEL
    tristate "Physical Mem Operation Driver"
    default y
    help
      Read-Write physical memory of target process.
      Also retrieves base address of any library within any target process.
      Y to statically build within kernel.
      M to build as loadable kernel module (lkm).
```

## drivers/rwMem/Kconfig
```kconfig
config RWMEM
	tristate "RWMEM support"
	default m
	help
	  Enable module rwmem
	  
```
